## app/boards/espressif/esp32c3_supermini/Kconfig.board
```kconfig
config BOARD_ESP32C3_SUPERMINI
    bool "ESP32-C3 SuperMini"
    depends on SOC_SERIES_ESP32C3
    select SOC_ESP32C3
```

## app/boards/espressif/esp32c3_supermini/Kconfig.defconfig
```kconfig
if BOARD_ESP32C3_SUPERMINI

config BOARD
    default "esp32c3_supermini"

config ZMK_KEYBOARD_NAME
    default "SuperMini Macropad"

config BT
    default y

config BT_CTLR
    default BT

config ZMK_BLE
    default y

config ZMK_USB
    default n

config ZMK_EC11
    default y

config ZMK_EC11_TRIGGER_GLOBAL_THREAD
    default y

endif # BOARD_ESP32C3_SUPERMINI
```

## app/boards/espressif/esp32c3_supermini/esp32c3_supermini_defconfig
```kconfig
CONFIG_SOC_SERIES_ESP32C3=y
CONFIG_BOARD_ESP32C3_SUPERMINI=y

CONFIG_CLOCK_CONTROL=y
CONFIG_ENTROPY_GENERATOR=y

# Bluetooth
CONFIG_BT=y
CONFIG_BT_PERIPHERAL=y
CONFIG_BT_DEVICE_NAME="SuperMini Macropad"

# GPIO
CONFIG_GPIO=y

# Flash storage
CONFIG_FLASH=y
CONFIG_FLASH_MAP=y
CONFIG_NVS=y
CONFIG_SETTINGS=y
CONFIG_SETTINGS_NVS=y

# Console (disable in production)
CONFIG_CONSOLE=n
CONFIG_UART_CONSOLE=n
```

## app/boards/shields/supermini_macropad/Kconfig.defconfig
```kconfig
# Copyright (c) 2026 The ZMK Contributors
# SPDX-License-Identifier: MIT

if SHIELD_SUPERMINI_MACROPAD

config ZMK_KEYBOARD_NAME
    default "SuperMini Macropad"

endif
```

## app/boards/shields/supermini_macropad/Kconfig.shield
```kconfig
config SHIELD_SUPERMINI_MACROPAD
    def_bool $(shields_list_contains,supermini_macropad)
```
